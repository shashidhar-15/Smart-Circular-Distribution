#include <reg52.h> 
#include <intrins.h>

// === Ultrasonic Sensor Pins === sbit TRIG = P1^2;
sbit ECHO = P1^3;

// === OLED I2C Pins ===
sbit OLED_SDA = P3^0; sbit OLED_SCL = P3^1; sbit OLED_RESET = P1^1;

// === OLED I2C Address ===
#define OLED_ADDR 0x78 // (0x3C << 1)

// === Delay Functions === void delay_us(unsigned int us) {
while (us--) { _nop_(); _nop_(); }
}

void delay_ms(unsigned int ms) { unsigned int i, j;
for(i = 0; i < ms; i++) for(j = 0; j < 127; j++);
}

// === I2C Functions === void I2C_Start(void) {
OLED_SDA = 1; OLED_SCL = 1; delay_us(5); OLED_SDA = 0; delay_us(5); OLED_SCL = 0;
}

void I2C_Stop(void) {
OLED_SDA = 0; OLED_SCL = 1; delay_us(5);
OLED_SDA = 1; delay_us(5);
}

bit I2C_SendByte(unsigned char dat) {
 
unsigned char i; bit ack;
for(i = 0; i < 8; i++) {
OLED_SDA = (dat & 0x80) ? 1 : 0;
dat <<= 1; delay_us(3);
OLED_SCL = 1; delay_us(6); OLED_SCL = 0; delay_us(3);
}
OLED_SDA = 1; delay_us(3); OLED_SCL = 1; delay_us(6); ack = !OLED_SDA;
OLED_SCL = 0; delay_us(3); return ack;
}

// === OLED Commands ===
void OLED_Write_Cmd(unsigned char cmd) { I2C_Start(); I2C_SendByte(OLED_ADDR); I2C_SendByte(0x00);
I2C_SendByte(cmd); I2C_Stop();
}

void OLED_Write_Data(unsigned char dat) { I2C_Start(); I2C_SendByte(OLED_ADDR); I2C_SendByte(0x40);
I2C_SendByte(dat); I2C_Stop();
}

void OLED_Set_Pos(unsigned char x, unsigned char y) { OLED_Write_Cmd(0xB0 + y); OLED_Write_Cmd(((x & 0xF0) >> 4) | 0x10); OLED_Write_Cmd(x & 0x0F);
}

void OLED_Clear(void) { unsigned char i, j;
for(i = 0; i < 8; i++) { OLED_Set_Pos(0, i); for(j = 0; j < 128; j++)
 
OLED_Write_Data(0x00);
}
}

void OLED_Clear_Line(unsigned char y) { unsigned char j;
OLED_Set_Pos(0, y); for(j = 0; j < 128; j++)
OLED_Write_Data(0x00);
}

// === Combined Font Table (62 characters) ===
// Indices:
//  0-25 : 'A'-'Z'
// 26-51 : 'a'-'z'
// 52-61 : '0'-'9'
static const unsigned char code font6x8_combined[][6] = {
// A-Z (0-25)
{0x7E,0x11,0x11,0x11,0x7E,0x00}, // A
{0x7F,0x49,0x49,0x49,0x36,0x00}, // B
{0x3E,0x41,0x41,0x41,0x22,0x00}, // C
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{0x61,0x51,0x49,0x45,0x43,0x00}, // Z
 
// a-z (26-51)
{0x20,0x54,0x54,0x54,0x78,0x00}, // a
{0x7F,0x48,0x44,0x44,0x38,0x00}, // b
{0x38,0x44,0x44,0x44,0x20,0x00}, // c
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{0x44,0x64,0x54,0x4C,0x44,0x00}, // z
// 0-9 (52-61)
{0x3E,0x51,0x49,0x45,0x3E,0x00}, // 0
{0x00,0x42,0x7F,0x40,0x00,0x00}, // 1
{0x42,0x61,0x51,0x49,0x46,0x00}, // 2
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{0x06,0x49,0x49,0x29,0x1E,0x00} // 9
};

// === OLED Display Functions ===
void OLED_Display_Char(unsigned char x, unsigned char y, char chr) { unsigned char i, index;
if (chr >= 'A' && chr <= 'Z') {
 
index = chr - 'A';
} else if (chr >= 'a' && chr <= 'z') { index = chr - 'a' + 26;
} else if (chr >= '0' && chr <= '9') { index = chr - '0' + 52;
} else {
return; // Unsupported character
}
OLED_Set_Pos(x, y); for (i = 0; i < 6; i++) {
OLED_Write_Data(font6x8_combined[index][i]);
}
}

void OLED_Display_String(unsigned char x, unsigned char y, char *str) { while (*str) {
OLED_Display_Char(x, y, *str); x += 6;
str++;
}
}

void OLED_Display_Number(unsigned char x, unsigned char y, unsigned int num) { char buf[6];
unsigned char i = 0, j; if (num == 0) {
buf[i++] = '0';
} else {
while (num > 0 && i < sizeof(buf)) { buf[i++] = (num % 10) + '0';
num /= 10;
}
}
for (j = 0; j < i; j++) {
OLED_Display_Char(x + j * 6, y, buf[i - 1 - j]);
}
}

// === OLED Initialization === void OLED_Init(void) {
OLED_RESET = 0; delay_ms(100); OLED_RESET = 1; delay_ms(100); OLED_Write_Cmd(0xAE);
OLED_Write_Cmd(0xD5); OLED_Write_Cmd(0x80);
 
OLED_Write_Cmd(0xA8); OLED_Write_Cmd(0x3F); OLED_Write_Cmd(0xD3); OLED_Write_Cmd(0x00);
OLED_Write_Cmd(0x40); OLED_Write_Cmd(0x8D); OLED_Write_Cmd(0x14); OLED_Write_Cmd(0xA1); OLED_Write_Cmd(0xC8);
OLED_Write_Cmd(0xDA); OLED_Write_Cmd(0x12);
OLED_Write_Cmd(0x81); OLED_Write_Cmd(0xCF); OLED_Write_Cmd(0xD9); OLED_Write_Cmd(0xF1);
OLED_Write_Cmd(0xDB); OLED_Write_Cmd(0x40); OLED_Write_Cmd(0xA4); OLED_Write_Cmd(0xA6); OLED_Write_Cmd(0xAF);
OLED_Clear();
}

// === Ultrasonic Sensor Measurement ===
// This function triggers the sensor and returns the raw time (in microseconds) unsigned int Measure_Raw_Time(void) {
unsigned int time; TRIG = 0; delay_us(2);
TRIG = 1; delay_us(10); TRIG = 0;
while (!ECHO);	// Wait for echo to go high TH0 = 0; TL0 = 0;		// Clear Timer0
TR0 = 1;	// Start Timer0
while (ECHO);		// Wait for echo to go low TR0 = 0;	// Stop Timer0
time = (TH0 << 8) | TL0;// Get the measured time TH0 = 0; TL0 = 0;
return time;
}

// === Main Program === void main(void) {
unsigned int raw_time, dist_inches, dist_cm; TMOD = 0x01; // Set Timer0 to 16-bit mode OLED_Init();

// Display static label
OLED_Display_String(0, 0, "Object detection:");

while (1) {
raw_time = Measure_Raw_Time();
// Calculate distances
// Inches conversion factor (example: 0.0133); centimeters conversion factor (example: 0.034)
dist_inches = (unsigned int)(raw_time * 0.0133);
 
dist_cm = (unsigned int)(raw_time * 0.034);

// If object is above 30 inches, display "No Object" if (dist_inches > 30) {
OLED_Clear_Line(2);
OLED_Clear_Line(3); OLED_Clear_Line(4);
OLED_Display_String(0, 2, "No Object");
} else {
OLED_Clear_Line(2);
OLED_Display_String(0, 2, "Distance: "); OLED_Display_Number(0, 3, dist_inches);
OLED_Display_String(15, 3, " In"); OLED_Display_Number(0, 4, dist_cm); OLED_Display_String(15, 4, " Cm: ");

}
delay_ms(300);
}
}
